#define EEPROM_A0 22
#define EEPROM_A1 23
#define EEPROM_A2 24
#define EEPROM_A3 25
#define EEPROM_A4 26
#define EEPROM_A5 27
#define EEPROM_A6 28
#define EEPROM_A7 29
#define EEPROM_A8 30
#define EEPROM_A9 31
#define EEPROM_A10 32
#define EEPROM_A11 33
#define EEPROM_A12 34
#define EEPROM_A13 35
#define EEPROM_A14 36

#define EEPROM_D0 40
#define EEPROM_D7 47
#define WRITE_EN 2
#define OUTPUT_EN 3

// Array of address pins to simplify setting them
int addressPins[] = {
  EEPROM_A0, EEPROM_A1, EEPROM_A2, EEPROM_A3, EEPROM_A4,
  EEPROM_A5, EEPROM_A6, EEPROM_A7, EEPROM_A8, EEPROM_A9,
  EEPROM_A10, EEPROM_A11, EEPROM_A12, EEPROM_A13, EEPROM_A14
};


// Finch image
byte imgPixels[] = {0x0,0x0,0x8,0x8,0x8,0x9,0x9,0x9,0x9,0x9,0x9,0x9,0x9,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0x5c,0x54};

// Bird image
//byte imgPixels[] = {0x08,0x08,0x08,0x08,0x08,0x08,0x08,0x08,0x08,0x08,0x08,0x08,0x10,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0x00,0x00};

/*
 * Output the address bits and outputEnable signal
 */
void setAddress(int address, bool outputEnable) {
  if (outputEnable) {
    digitalWrite(OUTPUT_EN, LOW);
  } else {
    digitalWrite(OUTPUT_EN, HIGH);
  }

  // Set each bit of the address on the corresponding pin
  for (int i = 0; i <= 14; i++) {  // Loop through all address bits (0 to 14)
    int bitValue = (address >> i) & 1; // Extract the bit i from the address
    digitalWrite(addressPins[i], bitValue); // Set the corresponding pin to the bit value
  }
}


/*
 * Read a byte from the EEPROM at the specified address.
 */
byte readEEPROM(int address) {
  for (int pin = EEPROM_D0; pin <= EEPROM_D7; pin += 1) {
    pinMode(pin, INPUT);
  }
  setAddress(address, /*outputEnable*/ true);

  byte data = 0;
  for (int pin = EEPROM_D7; pin >= EEPROM_D0; pin -= 1) {
    data = (data << 1) + digitalRead(pin);
  }
  return data;
}


/*
 * Read the contents of the EEPROM and print them to the serial monitor.
 */
void printContents() {
  
  //for (int base = 0; base <= 32752; base += 16) {
  for (int base = 0; base <= 255; base += 16) {
    byte data[16];
    for (int offset = 0; offset <= 15; offset += 1) {
      data[offset] = readEEPROM(base + offset);
    }

    char buf[80];
    sprintf(buf, "%05x:  %02x %02x %02x %02x %02x %02x %02x %02x   %02x %02x %02x %02x %02x %02x %02x %02x ",
            base, data[0], data[1], data[2], data[3], data[4], data[5], data[6], data[7],
            data[8], data[9], data[10], data[11], data[12], data[13], data[14], data[15]);

    Serial.println(buf);
  }
}


/*
 * Write a byte to the EEPROM at the specified address.
 */
void writeEEPROM(int address, byte data) {
  setAddress(address, /*outputEnable*/ false);
  for (int pin = EEPROM_D0; pin <= EEPROM_D7; pin += 1) {
    pinMode(pin, OUTPUT);
  }

  for (int pin = EEPROM_D0; pin <= EEPROM_D7; pin += 1) {
    digitalWrite(pin, data & 1);
    data = data >> 1;
  }
  digitalWrite(WRITE_EN, LOW);
  delayMicroseconds(1);
  digitalWrite(WRITE_EN, HIGH);
  delay(10);
}


void setup() {
  // Initialize address pins as output
  for (int i = 0; i <= 14; i++) {
    pinMode(addressPins[i], OUTPUT);
  }
  // Initialize control pins
  pinMode(WRITE_EN, OUTPUT);
  pinMode(OUTPUT_EN, OUTPUT);
  digitalWrite(WRITE_EN, HIGH);  // Disable writing by default
  digitalWrite(OUTPUT_EN, HIGH); // Disable output by default

  Serial.begin(57600);

  Serial.println("Programming EEPROM");
  int counter = 0;
  int counter2 = 0;
  for (int address = 0; address < 9584; address += 1) {             // For first half of EEPROM
  //for (int address = 16384; address < 25968; address += 1) {    // For second half of EEPROM
    if ((counter < 128) && (counter > 99)) {
      if (counter < 127) {
        counter ++;
      } else {
        counter = 0;
      }
    } else {
      writeEEPROM(address, imgPixels[counter2]);
      counter2 ++;
      counter ++;
    }
  }

  Serial.println(" done");
}

void loop() {
  // put your main code here, to run repeatedly:

}

